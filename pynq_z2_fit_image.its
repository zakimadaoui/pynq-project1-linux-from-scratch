## pynq_z2_fit_image.its
```
/dts-v1/;

/ {
    description = "U-Boot fitImage for PYNQ arm kernel";
    #address-cells = <1>;

    images {
        kernel {
            description = "Linux Kernel";
            data = /incbin/("./artifacts/zImage");
            type = "kernel";
            arch = "arm";
            os = "linux";
            compression = "none";
            load = <0x80000>;
            entry = <0x80000>;
            hash-1 {
                algo = "sha1";
            };
        };
        fdt {
            description = "Flattened Device Tree blob";
            data = /incbin/("./artifacts/system.dtb");
            type = "flat_dt";
            arch = "arm";
            compression = "none";
            hash-1 {
                algo = "sha1";
            };
        };
        
        ramdisk {
            description = "Initial RAM disk";
            data = /incbin/("./artifacts/initramfs.cpio.gz");
            type = "ramdisk";
            arch = "arm";
            os = "linux";
            compression = "none";
            hash-1 {
                algo = "sha1";
            };
        };
    };
    configurations {
        default = "conf-1";
        conf-1 {
            description = "Boot Linux kernel with FDT blob";
            kernel = "kernel";
            fdt = "fdt";
            ramdisk = "ramdisk";
            hash-1 {
                algo = "sha1";
            };
        };
    };
};
```
